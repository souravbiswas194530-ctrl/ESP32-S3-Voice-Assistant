/*
  ============================================================
  ESP32-S3 সম্পূর্ণ ভয়েস অ্যাসিস্ট্যান্ট
  ============================================================
  এই কোডে যা আছে:
  1. I2S মাইক্রোফোন থেকে অডিও রেকর্ড (স্বয়ংক্রিয় VAD দিয়ে, বাটন লাগবে না)
  2. OpenAI Whisper API দিয়ে Speech-to-Text
  3. Mood system (bad/good word detection, recovery timer)
  4. SD card এ SQLite-স্টাইল JSON ডেটাবেজে প্রশ্ন খোঁজা
  5. না পেলে GPT API কল করা + auto-save
  6. OpenAI TTS API দিয়ে Text-to-Speech
  7. I2S DAC দিয়ে অডিও প্লেব্যাক (CA-MT21 এ যাবে)
  8. OLED এ mood face দেখানো + speaker এ mood অনুযায়ী voice tone

  ============================================================
  *** আপনাকে যা বসাতে হবে ***
  1. OPENAI_API_KEY (নিচে)
  2. পিন নাম্বারগুলো (আপনার আসল ওয়্যারিং অনুযায়ী) - PIN CONFIG সেকশনে
  (WiFi কোডে বসাতে হবে না! প্রথমবার চালু করলে ESP32 নিজেই
   "VoiceAssistant-Setup" নামে একটা WiFi hotspot খুলবে।
   ফোন দিয়ে সেটাতে কানেক্ট করে সেখান থেকে আপনার আসল WiFi
   সিলেক্ট/লিখে দিলেই হবে। পরবর্তীতে ESP32 সেই WiFi মনে রাখবে।)
  ============================================================

  প্রয়োজনীয় লাইব্রেরি (Library Manager থেকে ইনস্টল করুন):
  - ArduinoJson (by Benoit Blanchon)
  - TFT_eSPI (by Bodmer) - Library Manager থেকে ইনস্টল করুন
    *** পিন কনফিগারেশন এই .ino ফাইলেই বসানো আছে
        (USER_SETUP_LOADED দিয়ে, #include <TFT_eSPI.h> এর
        আগে) - লাইব্রেরির User_Setup.h এডিট করার দরকার নেই ***
  - WiFiManager (by tzapu) - Library Manager থেকে ইনস্টল করুন
  - ESP32 বোর্ড প্যাকেজে থাকা "driver/i2s.h" ও "SD_MMC" (দুটোই বিল্ট-ইন)

  Board settings (Arduino IDE তে):
  - Board: "ESP32S3 Dev Module"
  - PSRAM: "OPI PSRAM" (N16R8 বোর্ডের জন্য)
  - Flash size: 16MB
  - Partition scheme: যেকোনো একটা যাতে বড় App + SPIFFS থাকে

  *** পিন নোট (যাচাইকৃত ওয়্যারিং ডায়াগ্রাম অনুযায়ী) ***
  - এই বোর্ডে মাত্র ৭টা ফ্রি GPIO: 1, 2, 14, 21, 41, 42, 47
  - মাইক ও DAC একই BCK(GPIO1)/WS(GPIO2) শেয়ার করে, তাই কোডে
    একটাই I2S পেরিফেরাল full-duplex মোডে ব্যবহার হচ্ছে
    (দেখুন setupI2S() ফাংশন)
  - TFT এর CS সরাসরি GND এ, RES ও BL সরাসরি 3.3V এ হার্ডওয়্যার্ড
  - ক্যামেরা ও SD card বোর্ডের বিল্ট-ইন স্লটে সরাসরি বসে, কোনো
    আলাদা GPIO লাগে না (SD_MMC লাইব্রেরি ডিফল্ট পিন ব্যবহার করে)
  ============================================================
*/

#include <WiFi.h>
#include <WiFiManager.h>
#include <WiFiMulti.h>
WiFiManager wifiManager;
WiFiMulti wifiMulti;

// ডেটাবেজ লুকআপ ফলাফল রাখার জন্য struct - এটা ব্যবহারের অনেক আগেই
// (উপরে) ডিফাইন করা হলো, নাহলে C++ কম্পাইল এরর দেয়
struct LookupResult {
  String answer;
  bool found;
  bool needsRefresh;   // volatile এন্ট্রি পুরনো হয়ে গেলে true
};
#include <WiFiClientSecure.h>
#include <HTTPClient.h>
#include <ArduinoJson.h>
#include <FS.h>
#include <SD_MMC.h>
#include <SPI.h>
#include <Wire.h>
// (Adafruit_GFX.h এখন আর লাগে না - TFT_eSPI নিজেই সব ড্রয়িং ফাংশন দেয়,
// আগে Adafruit_SSD1306 ব্যবহার হতো যখন এটার দরকার ছিল)

// ============================================================
// TFT_eSPI পিন কনফিগারেশন - সরাসরি এই .ino ফাইলেই!
// এভাবে করলে লাইব্রেরির ভেতরের User_Setup.h এডিট করার
// আর কোনো দরকার নেই (মোবাইলে ওই ফাইল খুঁজে এডিট করা কঠিন,
// তাই এই পদ্ধতি ব্যবহার করা হলো - TFT_eSPI অফিসিয়ালিই এটা
// সাপোর্ট করে)। #include <TFT_eSPI.h> এর ঠিক আগে বসাতে হয়।
// ============================================================
#define USER_SETUP_LOADED 1
#define ST7789_DRIVER
#define TFT_WIDTH  172
#define TFT_HEIGHT 320
#define TFT_CS   -1   // CS সরাসরি GND এ হার্ডওয়্যার্ড
#define TFT_DC    47
#define TFT_RST  -1   // RST সরাসরি 3.3V এ হার্ডওয়্যার্ড
#define TFT_SCLK  41
#define TFT_MOSI  42
#define LOAD_GLCD
#define LOAD_FONT2
#define LOAD_FONT4
#define LOAD_FONT6
#define LOAD_FONT7
#define LOAD_FONT8
#define LOAD_GFXFF
#define SMOOTH_FONT
#define SPI_FREQUENCY  27000000

#include <TFT_eSPI.h>   // ST7789 1.47" TFT
// বাংলা + English Smooth Font ডেটা (HindSiliguri18[]) এই ফাইলের একদম নিচে
// সরাসরি বসানো আছে। এখানে শুধু forward declaration দেওয়া হলো যাতে
// showMessage()/drawFace() ফাংশন (যেগুলো এই ফন্ট আগে ব্যবহার করে,
// অ্যারে ডিফাইন হওয়ার আগে) কম্পাইল করতে পারে।
extern const uint8_t HindSiliguri18[] PROGMEM;
#include <driver/i2s.h>
#include <time.h>

// ============================================================
// ১. WiFi কনফিগারেশন (একাধিক WiFi/হটস্পট যোগ করা যায়)
//    setup() ফাংশনে নিচের তালিকা থেকে যেটার সিগন্যাল সবচেয়ে
//    ভালো পাবে, স্বয়ংক্রিয়ভাবে সেটাতেই কানেক্ট হবে।
// ============================================================
// (WiFi তালিকা setupMultiWiFi() ফাংশনে দেওয়া আছে, নিচে খুঁজুন)

const char* OPENAI_API_KEY = "YOUR_API_KEY_HERE";

// ============================================================
// ২. পিন কনফিগারেশন — যাচাইকৃত wiring diagram অনুযায়ী
//    (ESP32-S3 N16R8 CAM বোর্ডে মোট মাত্র ৭টা ফ্রি GPIO আছে:
//     1, 2, 14, 21, 41, 42, 47 — বাকি সব ক্যামেরা/SD/PSRAM/
//     USB/UART/Boot/LED এর জন্য আগে থেকেই সংরক্ষিত)
// ============================================================
// --- I2S মাইক্রোফোন (INMP441) - রেকর্ডিং এর জন্য ---
// *** মাইক ও DAC একই BCK/WS শেয়ার করে (নিচে I2S FULL-DUPLEX নোট দেখুন) ***
#define I2S_MIC_SCK   1    // BCK - DAC এর BCK এর সাথে শেয়ার্ড
#define I2S_MIC_WS    2    // WS  - DAC এর LRCK এর সাথে শেয়ার্ড
#define I2S_MIC_SD    14   // ডেটা ইন (মাইক থেকে)

// --- I2S DAC (PCM5102A) - প্লেব্যাকের জন্য (CA-MT21 এ যাবে) ---
#define I2S_DAC_BCLK  1    // মাইকের SCK এর সাথে শেয়ার্ড পিন
#define I2S_DAC_LRC   2    // মাইকের WS এর সাথে শেয়ার্ড পিন
#define I2S_DAC_DIN   21   // ডেটা আউট (DAC এ)
// PCM5102A বোর্ডের নিজস্ব SCK পিন → GND (internal clock)
// PCM5102A XSMT পিন → 3.3V (mute বন্ধ রাখতে)

// --- TFT LCD (ST7789, 1.47" SPI) ---
// পিন কনফিগারেশন এই ফাইলের উপরের দিকে (TFT_eSPI.h include এর
// আগে, USER_SETUP_LOADED ব্লকে) বসানো আছে - এখানে নিচে শুধু
// রেফারেন্সের জন্য দেখানো হলো, এগুলো আলাদা করে ব্যবহার হয় না:
// CS=-1(GND), DC=47, RST=-1(3.3V), SCLK=41, MOSI=42, BL=3.3V

// --- SD Card ---
// বোর্ডের বিল্ট-ইন microSD স্লটে সরাসরি ঢোকান - এটা আগে থেকেই
// বোর্ডে ওয়্যার করা (SD_MMC), তাই আলাদা GPIO define করার দরকার নেই

// --- বাটন (push-to-talk) ---
// *** এই বোর্ডে বাটন নেই - কোড অটো-VAD দিয়ে চলে (বাটন ছাড়াই)।
// GPIO 0 (BOOT) এই বোর্ডে সংরক্ষিত, তাই বাটন পিন define/ব্যবহার
// দুটোই বাদ দেওয়া হলো (নিচে setup() এও pinMode লাইনটা সরানো হয়েছে)।

// ============================================================
// ৩. অন্যান্য কনফিগারেশন (সাধারণত পরিবর্তনে��� দরকার নেই)
// ============================================================
#define SCREEN_WIDTH  172   // 1.47" ST7789 রেজোলিউশন
#define SCREEN_HEIGHT 320
TFT_eSPI display = TFT_eSPI();

#define SAMPLE_RATE     16000
#define RECORD_SECONDS  5
#define RECORD_SAMPLES  (SAMPLE_RATE * RECORD_SECONDS)

// ============================================================
// Mood সিস্টেম ভ্যারিয়েবল
// ============================================================
int moodScore = 75;
bool isSpeaking = false; // TTS/রেকর্ডিং চলাকালীন VAD বন্ধ রাখতে
unsigned long lastBadTime = 0;
bool inRecoveryMode = false;

const char* badWords[] = {"গাধা", "বোকা", "খারাপ", "বদমাশ", "বাজে"};
const int badWordsCount = 5;
const char* goodWords[] = {"ধন্যবাদ", "ভালো", "চমৎকার", "সুন্দর", "থ্যাংকস"};
const int goodWordsCount = 5;

// ============================================================
// SETUP
// ============================================================
void setup() {
  Serial.begin(115200);
  delay(500);

  // --- TFT LCD (SPI) ---
  // Backlight সরাসরি 3.3V এ হার্ডওয়্যার্ড, তাই কোনো pinMode/digitalWrite লাগবে না
  display.init();
  display.setRotation(0);           // দরকার হলে 1/2/3 করে ঘুরিয়ে দেখুন
  display.fillScreen(TFT_BLACK);
  showMessage("চালু হচ্ছে...");

  // --- SD Card (বোর্ডের বিল্ট-ইন slot, SD_MMC দিয়ে) ---
  if (!SD_MMC.begin("/sdcard", true)) {  // true = 1-bit মোড
    Serial.println("SD card পাওয়া যায়নি! কার্ড ঢোকানো/ফরম্যাট চেক করুন।");
    showMessage("SD card এরর!");
  } else {
    Serial.println("SD card ready");
    ensureDatabaseExists();
  }

  // --- I2S সেটআপ (মাইক + স্পিকার, শেয়ার্ড পিনে full-duplex) ---
  setupI2S();

  // --- WiFi (SD card এর তালিকা থেকে স্বয়ংক্রিয় কানেক্ট, বাটন লাগবে না) ---
  setupWiFi();

  showMessage("রেডি! বাটন চাপুন");
  drawFace(moodScore);
}

// ============================================================
// MAIN LOOP
// ============================================================
void loop() {
  checkMoodRecovery();

  // বাটন ছাড়াই - সবসময় মাইক্রোফোন মনিটর করে, কথা বলা শুরু হলেই
  // স্বয়ংক্রিয়ভাবে রেকর্ডিং শুরু হবে
  if (!isSpeaking && detectVoiceActivity()) {
    handleVoiceInteraction();
    delay(500); // পরের ডিটেকশনের আগে একটু বিরতি (echo/feedback এড়াতে)
  }

  delay(20);
}

// ============================================================
// Voice Activity Detection (VAD) - মাইক্রোফোনের আওয়াজের মাত্রা চেক করে
// কেউ কথা বলা শুরু করেছে কিনা বোঝার চেষ্টা করে
// ============================================================
const int VAD_THRESHOLD = 300;       // কম মান = হালকা আওয়াজেও ট্রিগার হবে (হার্ডওয়্যারে টেস্ট করে টিউন করুন)
const int VAD_SAMPLE_COUNT = 256;    // কতগুলো sample নিয়ে গড় নেওয়া হবে

bool detectVoiceActivity() {
  int32_t rawBuffer[VAD_SAMPLE_COUNT];
  size_t bytesRead;

  i2s_read(I2S_NUM_0, rawBuffer, sizeof(rawBuffer), &bytesRead, 50 / portTICK_PERIOD_MS);
  int samplesRead = bytesRead / sizeof(int32_t);
  if (samplesRead <= 0) return false;

  // গড় absolute amplitude হিসাব করা (RMS এর সহজ approximation)
  long sum = 0;
  for (int i = 0; i < samplesRead; i++) {
    int16_t sample = (int16_t)(rawBuffer[i] >> 14);
    sum += abs(sample);
  }
  int avgAmplitude = sum / samplesRead;

  return avgAmplitude > VAD_THRESHOLD;
}

// ============================================================
// পুরো ভয়েস ইন্টারঅ্যাকশন প্রবাহ
// ============================================================
void handleVoiceInteraction() {
  isSpeaking = true; // VAD সাময়িকভাবে বন্ধ, যাতে নিজের কথা/স্পিকারের আওয়াজ ধরে আবার ট্রিগার না হয়
  showMessage("শুনছি...");

  // ধাপ ১: অডিও রেকর্ড করুন
  int16_t* audioBuffer = recordAudio();
  if (audioBuffer == nullptr) {
    showMessage("রেকর্ড এরর!");
    isSpeaking = false;
    return;
  }

  // ধাপ ২: Whisper API দিয়ে Speech-to-Text
  showMessage("বুঝার চেষ্টা করছি...");
  String question = speechToText(audioBuffer, RECORD_SAMPLES);
  free(audioBuffer);

  if (question.length() == 0) {
    showMessage("কিছু বুঝিনি, আবার বলুন");
    speakAndShow("দুঃখিত, বুঝতে পারিনি।");
    isSpeaking = false;
    return;
  }

  Serial.println("প্রশ্ন: " + question);

  // ধাপ ৩: Mood আপডেট
  if (containsBadWord(question)) {
    decreaseMood(20);
  } else if (containsGoodWord(question)) {
    increaseMood(12);
  }
  drawFace(moodScore);

  // ধাপ ৩.৪: এটা কি "মনে রাখো" কমান্ড? (API ছাড়াই সরাসরি SD card এ সেভ)
  if (handleRememberCommand(question)) {
    isSpeaking = false;
    return;
  }

  // ধাপ ৩.৪৫: এটা কি কম্পিউটার কন্ট্রোল কমান্ড? (USB Serial দিয়ে)
  if (handleComputerCommand(question)) {
    isSpeaking = false;
    return;
  }

  // ধাপ ৩.৫: এটা কি Call বা SMS কমান্ড? (API ছাড়াই, প্যাটার্ন ম্যাচিং দিয়ে)
  if (handleCallOrSMSCommand(question)) {
    isSpeaking = false;
    return; // কল/SMS কমান্ড হ্যান্ডেল হয়ে গেছে, বাকি প্রশ্ন প্রসেসিং লাগবে না
  }

  // ধাপ ৪: mood ০-৫ হলে উত্তর দেবে না
  if (moodScore <= 5) {
    speakAndShow("আমি এখন কথা বলতে চাই না...");
    isSpeaking = false;
    return;
  }

  // ধাপ ৫: লোকাল ডেটাবেজে খুঁজুন
  showMessage("ভাবছি...");
  LookupResult localResult = searchLocalDatabase(question);

  if (localResult.found && !localResult.needsRefresh) {
    // সাধারণ (অপরিবর্তনীয়) তথ্য অথবা এখনো "তাজা" volatile তথ্য
    Serial.println("লোকাল ডেটাবেজ থেকে উত্তর পাওয়া গেছে (ফ্রি)");
    speakAndShow(localResult.answer);

  } else if (localResult.found && localResult.needsRefresh) {
    // volatile তথ্য কিন্তু পুরনো হয়ে গেছে -> API দিয়ে যাচাই করুন
    Serial.println("পুরনো volatile তথ্য, API দিয়ে যাচাই করা হচ্ছে...");
    String apiAnswer = callChatGPT(question);
    if (apiAnswer != "") {
      speakAndShow(apiAnswer);
      saveToLocalDatabase(question, apiAnswer, true); // volatile হিসেবেই থাকবে
    } else {
      // ইন্টারনেট/API না থাকলে পুরনো উত্তরই দিন, কিছু না বলার চেয়ে ভালো
      speakAndShow(localResult.answer);
    }

  } else {
    // ডেটাবেজে একদমই নেই -> নতুন প্রশ্ন
    Serial.println("API কল করা হচ্ছে...");
    String apiAnswer = callChatGPT(question);
    if (apiAnswer != "") {
      speakAndShow(apiAnswer);
      bool isVolatile = looksVolatile(question);
      saveToLocalDatabase(question, apiAnswer, isVolatile);
    } else {
      speakAndShow("দুঃখিত, উত্তর আনতে সমস্যা হয়েছে।");
    }
  }

  isSpeaking = false; // এখন আবার VAD সক্রিয় হবে, স্বাভাবিকভাবে শুনতে থাকবে
}

// প্রশ্নে "বর্তমান", "সবচেয়ে বেশি", "রেকর্ড", "এখন" ইত্যাদি শব্দ থাকলে
// এটাকে volatile (পরিবর্তনশীল) হিসেবে চিহ্নিত করা - এই ধরনের তথ্য
// ভবিষ্যতে বদলে যাওয়ার সম্ভাবনা বেশি
bool looksVolatile(String question) {
  const char* volatileHints[] = {
    "বর্তমান", "এখন", "সাম্প্রতিক", "সর্বোচ্চ", "রেকর্ড",
    "সর্বশেষ", "নতুন", "কে জিতেছে", "চলতি"
  };
  for (int i = 0; i < 9; i++) {
    if (question.indexOf(volatileHints[i]) >= 0) return true;
  }
  return false;
}

// ============================================================
// I2S মাইক্রোফোন সেটআপ ও রেকর্ডিং
// ============================================================
// *** নতুন ওয়্যারিং অনুযায়ী মাইক ও DAC একই BCK(GPIO1)/WS(GPIO2)
// পিন শেয়ার করে, তাই দুট�� আলাদা I2S পেরিফেরাল (I2S_NUM_0 আর
// I2S_NUM_1) একসাথে মাস্টার হিসেবে বসালে পিন কনফ্লিক্ট হবে।
// তাই এখন একটাই I2S পেরিফেরাল (I2S_NUM_0) TX+RX (full-duplex)
// মোডে বসানো হচ্ছে, এবং রেকর্ড/প্লেব্যাকের আগে sample rate ও
// bit-depth i2s_set_clk() দিয়ে দরকারমতো বদলে নেওয়া হচ্ছে
// (যেহেতু মাইক ও স্পিকার কখনো একসাথে চলে না) ***
// ============================================================
void setupI2S() {
  i2s_config_t i2s_config = {
    .mode = (i2s_mode_t)(I2S_MODE_MASTER | I2S_MODE_TX | I2S_MODE_RX),
    .sample_rate = SAMPLE_RATE,
    .bits_per_sample = I2S_BITS_PER_SAMPLE_32BIT,
    .channel_format = I2S_CHANNEL_FMT_ONLY_LEFT,
    .communication_format = I2S_COMM_FORMAT_STAND_I2S,
    .intr_alloc_flags = ESP_INTR_FLAG_LEVEL1,
    .dma_buf_count = 8,
    .dma_buf_len = 256,
    .use_apll = false
  };

  i2s_pin_config_t pin_config = {
    .bck_io_num = I2S_MIC_SCK,      // = I2S_DAC_BCLK (শেয়ার্ড, GPIO 1)
    .ws_io_num = I2S_MIC_WS,        // = I2S_DAC_LRC  (শেয়ার্ড, GPIO 2)
    .data_out_num = I2S_DAC_DIN,    // GPIO 21 (স্পিকারে)
    .data_in_num = I2S_MIC_SD       // GPIO 14 (মাইক থেকে)
  };

  i2s_driver_install(I2S_NUM_0, &i2s_config, 0, NULL);
  i2s_set_pin(I2S_NUM_0, &pin_config);
}

int16_t* recordAudio() {
  int16_t* buffer = (int16_t*)malloc(RECORD_SAMPLES * sizeof(int16_t));
  if (buffer == nullptr) {
    Serial.println("মেমরি অ্যালোকেশন ব্যর্থ! (PSRAM চালু আছে তো?)");
    return nullptr;
  }

  // মাইকের জন্য ক্লক/ফরম্যাট সেট করা (16kHz, 32-bit, মোনো)
  i2s_set_clk(I2S_NUM_0, SAMPLE_RATE, I2S_BITS_PER_SAMPLE_32BIT, I2S_CHANNEL_MONO);

  int32_t rawBuffer[256];
  size_t bytesRead;
  int samplesCollected = 0;

  while (samplesCollected < RECORD_SAMPLES) {
    i2s_read(I2S_NUM_0, rawBuffer, sizeof(rawBuffer), &bytesRead, portMAX_DELAY);
    int samplesInChunk = bytesRead / sizeof(int32_t);

    for (int i = 0; i < samplesInChunk && samplesCollected < RECORD_SAMPLES; i++) {
      // 32-bit I2S sample কে 16-bit এ কনভার্ট করা (INMP441 সাধারণত উপরের 18 বিট ব্যবহার করে)
      buffer[samplesCollected++] = (int16_t)(rawBuffer[i] >> 14);
    }
  }

  return buffer;
}

void playAudioBuffer(uint8_t* audioData, size_t length) {
  size_t bytesWritten;
  i2s_write(I2S_NUM_0, audioData, length, &bytesWritten, portMAX_DELAY);
}

// ============================================================
// Whisper API দিয়ে Speech-to-Text
// ============================================================
String speechToText(int16_t* audioBuffer, int sampleCount) {
  if (WiFi.status() != WL_CONNECTED) return "";

  // WAV হেডার বানানো
  int dataSize = sampleCount * sizeof(int16_t);
  uint8_t* wavBuffer = (uint8_t*)malloc(44 + dataSize);
  if (!wavBuffer) return "";

  buildWavHeader(wavBuffer, dataSize, SAMPLE_RATE);
  memcpy(wavBuffer + 44, audioBuffer, dataSize);

  WiFiClientSecure client;
  client.setInsecure();  // প্রোডাকশনে proper certificate validation রাখা ভালো

  HTTPClient http;
  http.begin(client, "https://api.openai.com/v1/audio/transcriptions");
  http.addHeader("Authorization", String("Bearer ") + OPENAI_API_KEY);

  String boundary = "----ESP32Boundary";
  String contentType = "multipart/form-data; boundary=" + boundary;
  http.addHeader("Content-Type", contentType);

  String bodyStart = "--" + boundary + "\r\n"
    "Content-Disposition: form-data; name=\"model\"\r\n\r\nwhisper-1\r\n"
    "--" + boundary + "\r\n"
    "Content-Disposition: form-data; name=\"file\"; filename=\"audio.wav\"\r\n"
    "Content-Type: audio/wav\r\n\r\n";
  String bodyEnd = "\r\n--" + boundary + "--\r\n";

  int totalLen = bodyStart.length() + 44 + dataSize + bodyEnd.length();
  uint8_t* fullBody = (uint8_t*)malloc(totalLen);
  int pos = 0;
  memcpy(fullBody + pos, bodyStart.c_str(), bodyStart.length()); pos += bodyStart.length();
  memcpy(fullBody + pos, wavBuffer, 44 + dataSize); pos += 44 + dataSize;
  memcpy(fullBody + pos, bodyEnd.c_str(), bodyEnd.length()); pos += bodyEnd.length();

  int httpCode = http.POST(fullBody, totalLen);
  String result = "";

  if (httpCode == 200) {
    String response = http.getString();
    StaticJsonDocument<2048> doc;
    deserializeJson(doc, response);
    result = doc["text"].as<String>();
  } else {
    Serial.println("STT API এরর কোড: " + String(httpCode));
    Serial.println(http.getString());
  }

  http.end();
  free(wavBuffer);
  free(fullBody);
  return result;
}

void buildWavHeader(uint8_t* header, int dataSize, int sampleRate) {
  int fileSize = dataSize + 36;
  memcpy(header, "RIFF", 4);
  header[4] = fileSize & 0xFF; header[5] = (fileSize >> 8) & 0xFF;
  header[6] = (fileSize >> 16) & 0xFF; header[7] = (fileSize >> 24) & 0xFF;
  memcpy(header + 8, "WAVE", 4);
  memcpy(header + 12, "fmt ", 4);
  header[16] = 16; header[17] = 0; header[18] = 0; header[19] = 0;
  header[20] = 1; header[21] = 0;           // PCM
  header[22] = 1; header[23] = 0;           // mono
  header[24] = sampleRate & 0xFF; header[25] = (sampleRate >> 8) & 0xFF;
  header[26] = (sampleRate >> 16) & 0xFF; header[27] = (sampleRate >> 24) & 0xFF;
  int byteRate = sampleRate * 2;
  header[28] = byteRate & 0xFF; header[29] = (byteRate >> 8) & 0xFF;
  header[30] = (byteRate >> 16) & 0xFF; header[31] = (byteRate >> 24) & 0xFF;
  header[32] = 2; header[33] = 0;           // block align
  header[34] = 16; header[35] = 0;          // bits per sample
  memcpy(header + 36, "data", 4);
  header[40] = dataSize & 0xFF; header[41] = (dataSize >> 8) & 0xFF;
  header[42] = (dataSize >> 16) & 0xFF; header[43] = (dataSize >> 24) & 0xFF;
}

// ============================================================
// ChatGPT API কল করা
// ============================================================
String callChatGPT(String question) {
  if (WiFi.status() != WL_CONNECTED) return "";

  WiFiClientSecure client;
  client.setInsecure();

  HTTPClient http;
  http.begin(client, "https://api.openai.com/v1/chat/completions");
  http.addHeader("Content-Type", "application/json");
  http.addHeader("Authorization", String("Bearer ") + OPENAI_API_KEY);

  StaticJsonDocument<1024> reqDoc;
  reqDoc["model"] = "gpt-4o-mini";
  reqDoc["max_tokens"] = 200;
  JsonArray messages = reqDoc.createNestedArray("messages");
  JsonObject sysMsg = messages.createNestedObject();
  sysMsg["role"] = "system";
  sysMsg["content"] = "তুমি একজন সহায়ক ভয়েস অ্যাসিস্ট্যান্ট। সংক্ষিপ্ত ও সহজ ভাষায় বাংলায় উত্তর দাও।";
  JsonObject userMsg = messages.createNestedObject();
  userMsg["role"] = "user";
  userMsg["content"] = question;

  String requestBody;
  serializeJson(reqDoc, requestBody);

  int httpCode = http.POST(requestBody);
  String answer = "";

  if (httpCode == 200) {
    String response = http.getString();
    DynamicJsonDocument resDoc(4096);
    deserializeJson(resDoc, response);
    answer = resDoc["choices"][0]["message"]["content"].as<String>();
  } else {
    Serial.println("GPT API এরর কোড: " + String(httpCode));
  }

  http.end();
  return answer;
}

// ============================================================
// OpenAI TTS API দিয়ে উত্তর বলা
// ============================================================
void speakAndShow(String text) {
  showMessage(text);

  if (WiFi.status() != WL_CONNECTED) return;

  WiFiClientSecure client;
  client.setInsecure();

  HTTPClient http;
  http.begin(client, "https://api.openai.com/v1/audio/speech");
  http.addHeader("Content-Type", "application/json");
  http.addHeader("Authorization", String("Bearer ") + OPENAI_API_KEY);

  StaticJsonDocument<512> reqDoc;
  reqDoc["model"] = "tts-1";
  reqDoc["input"] = text;
  reqDoc["voice"] = "alloy";
  reqDoc["response_format"] = "pcm"; // raw PCM যাতে সরাসরি I2S তে পাঠানো যায়

  String requestBody;
  serializeJson(reqDoc, requestBody);

  int httpCode = http.POST(requestBody);

  if (httpCode == 200) {
    // স্পিকারের জন্য ক্লক/ফরম্যাট সেট করা (22050Hz, 16-bit, স্টেরিও) - প্লেব্যাক শুরুর আগে একবারই
    i2s_set_clk(I2S_NUM_0, 22050, I2S_BITS_PER_SAMPLE_16BIT, I2S_CHANNEL_STEREO);
    i2s_zero_dma_buffer(I2S_NUM_0);

    WiFiClient* stream = http.getStreamPtr();
    uint8_t buf[1024];
    int len;
    while (http.connected() && (len = stream->readBytes(buf, sizeof(buf))) > 0) {
      playAudioBuffer(buf, len);
    }

    // প্লেব্যাক শেষ, আবার মাইক/VAD এর ফরম্যাটে ফিরিয়ে আনা
    i2s_set_clk(I2S_NUM_0, SAMPLE_RATE, I2S_BITS_PER_SAMPLE_32BIT, I2S_CHANNEL_MONO);
  } else {
    Serial.println("TTS API এরর কোড: " + String(httpCode));
  }

  http.end();
  drawFace(moodScore);
}

// ============================================================
// Mood বাড়ানো/কমানো ও রিকভারি
// ============================================================
void decreaseMood(int amount) {
  moodScore = max(0, moodScore - amount);
  lastBadTime = millis();
  inRecoveryMode = true;
}

void increaseMood(int amount) {
  moodScore = min(100, moodScore + amount);
}

void checkMoodRecovery() {
  if (!inRecoveryMode) return;
  unsigned long elapsed = millis() - lastBadTime;

  if (elapsed >= 120000) {
    moodScore = 100;
    inRecoveryMode = false;
    drawFace(moodScore);
  } else if (elapsed >= 60000 && moodScore < 75) {
    moodScore = 75;
    drawFace(moodScore);
  }
}

bool containsBadWord(String text) {
  for (int i = 0; i < badWordsCount; i++)
    if (text.indexOf(badWords[i]) >= 0) return true;
  return false;
}

bool containsGoodWord(String text) {
  for (int i = 0; i < goodWordsCount; i++)
    if (text.indexOf(goodWords[i]) >= 0) return true;
  return false;
}

// ============================================================
// ============================================================
// TFT ডিসপ্লে ফাংশন - বাংলা + English Smooth Font + word-wrap + auto-scroll
// HindSiliguri18.h হলো TFT_eSPI Smooth Font।
// ============================================================

const int TFT_LINE_HEIGHT = 24; // 18px font-এর জন্য

void showMessage(String msg) {
  Serial.println("[ডিসপ্লে] " + msg);

  // বাংলা + English font RAM-এ load করা হচ্ছে
  display.loadFont(HindSiliguri18);
  display.setTextColor(TFT_WHITE, TFT_BLACK);
  display.setTextDatum(TL_DATUM);
  display.setTextWrap(false);
  display.fillScreen(TFT_BLACK);

  String lines[40];
  int totalLines = wrapTextIntoLines(msg, lines, 40);
  int maxVisibleLines = SCREEN_HEIGHT / TFT_LINE_HEIGHT;

  if (totalLines <= maxVisibleLines) {
    for (int i = 0; i < totalLines; i++) {
      display.drawString(lines[i], 4, 4 + i * TFT_LINE_HEIGHT);
    }
  } else {
    int startLine = 0;
    while (startLine < totalLines) {
      display.fillScreen(TFT_BLACK);

      int shown = 0;
      for (int i = startLine;
           i < totalLines && shown < maxVisibleLines;
           i++, shown++) {
        display.drawString(lines[i], 4, 4 + shown * TFT_LINE_HEIGHT);
      }

      delay(1800);
      startLine += maxVisibleLines;
    }
  }

  // Smooth Font unload করলে পরের কাজের জন্য RAM মুক্ত থাকে
  display.unloadFont();
}

// UTF-8 বাংলা + English text-কে TFT-এর pixel width অনুযায়ী word-wrap করে।
int wrapTextIntoLines(String text, String* lines, int maxLines) {
  int lineCount = 0;
  String currentLine = "";
  const int maxWidth = SCREEN_WIDTH - 8;

  int start = 0;
  while (start < text.length() && lineCount < maxLines) {
    int spaceIdx = text.indexOf(' ', start);
    String word = (spaceIdx == -1)
                    ? text.substring(start)
                    : text.substring(start, spaceIdx);

    String testLine = currentLine.length()
                        ? currentLine + " " + word
                        : word;

    if (display.textWidth(testLine) > maxWidth &&
        currentLine.length() > 0) {
      lines[lineCount++] = currentLine;
      currentLine = word;
    } else {
      currentLine = testLine;
    }

    if (spaceIdx == -1) break;
    start = spaceIdx + 1;
  }

  if (currentLine.length() > 0 && lineCount < maxLines) {
    lines[lineCount++] = currentLine;
  }

  return lineCount;
}

void drawFace(int mood) {
  String faceText;
  if (mood <= 5)         faceText = "কথা বলতে চাই না";
  else if (mood <= 25)   faceText = "মন খুব খারাপ";
  else if (mood <= 50)   faceText = "সামান্য মন খারাপ";
  else if (mood <= 75)   faceText = "নিউট্রাল";
  else                   faceText = "খুশি!";

  showMessage(faceText + " (Mood: " + String(mood) + ")");
}

// ============================================================
// SD Card / লোকাল ডেটাবেজ (একটাই JSON ফাইলে: WiFi + contacts + প্রশ্ন-উত্তর)
// ফরম্যাট: { "wifi": [...], "contacts": [...], "questions": [...] }
// ============================================================
void ensureDatabaseExists() {
  File testFile = SD_MMC.open("/qa_database.json", FILE_READ);
  if (testFile) {
    testFile.close();
    return;
  }

  File file = SD_MMC.open("/qa_database.json", FILE_WRITE);
  if (file) {
    file.println("{\"wifi\":[],\"contacts\":[],\"questions\":[]}");
    file.close();
    Serial.println("নতুন ডেটাবেজ ফাইল তৈরি করা হলো");
  }
}

// ফলাফল রাখার জন্য একটা struct - উপরে টাইপ ডেফিনিশন সেকশনে সরানো হয়েছে
const int FRESHNESS_DAYS = 30; // volatile তথ্য এই দিন পর পুরনো ধরা হবে

LookupResult searchLocalDatabase(String question) {
  LookupResult result;
  result.found = false;
  result.needsRefresh = false;

  File file = SD_MMC.open("/qa_database.json");
  if (!file) return result;

  DynamicJsonDocument doc(20480); // ডেটাবেজ বড় হলে সাইজ বাড়ান
  DeserializationError error = deserializeJson(doc, file);
  file.close();
  if (error) return result;

  JsonArray arr = doc["questions"].as<JsonArray>();
  String bestAnswer = "";
  bool bestVolatile = false;
  String bestLastUpdated = "";
  int bestScore = 0;
  const int MATCH_THRESHOLD = 2;

  for (JsonObject item : arr) {
    String storedQ = item["question"].as<String>();
    int score = keywordOverlapScore(question, storedQ);
    if (score > bestScore) {
      bestScore = score;
      bestAnswer = item["answer"].as<String>();
      bestVolatile = item["volatile"] | false;   // ডিফল্ট false
      bestLastUpdated = item["last_updated"] | "";
    }
  }

  if (bestScore >= MATCH_THRESHOLD) {
    result.found = true;
    result.answer = bestAnswer;

    if (bestVolatile) {
      // পরিবর্তনশীল তথ্য -> কতদিন পুরনো চেক করুন
      if (bestLastUpdated == "" || isOlderThanDays(bestLastUpdated, FRESHNESS_DAYS)) {
        result.needsRefresh = true;
      }
    }
  }

  return result;
}

// দুটো তারিখ (YYYY-MM-DD ফরম্যাট) এর পার্থক্য নির্দিষ্ট দিনের বেশি কিনা চেক করা
// (সহজ approximation - বছর/মাস/দিন থেকে মোট দিন হিসাব করে তুলনা)
bool isOlderThanDays(String dateStr, int days) {
  if (dateStr.length() < 10) return true; // ফরম্যাট ভুল হলে নিরাপদভাবে refresh করান

  int y = dateStr.substring(0, 4).toInt();
  int m = dateStr.substring(5, 7).toInt();
  int d = dateStr.substring(8, 10).toInt();

  // সংরক্ষিত তারিখকে আনুমানিক দিন-সংখ্যায় রূপান্তর
  long storedDays = (long)y * 365 + m * 30 + d;

  // বর্তমান তারিখ NTP/সিস্টেম টাইম থেকে (ধরে নিচ্ছি time.h দিয়ে সেট করা আছে)
  time_t now;
  time(&now);
  struct tm* nowTm = localtime(&now);
  long nowDays = (long)(nowTm->tm_year + 1900) * 365 + (nowTm->tm_mon + 1) * 30 + nowTm->tm_mday;

  return (nowDays - storedDays) > days;
}

// আজকের তারিখ YYYY-MM-DD ফরম্যাটে রিটার্ন করে (last_updated এ সেভ করতে)
String getTodayDateString() {
  time_t now;
  time(&now);
  struct tm* nowTm = localtime(&now);
  char buf[11];
  sprintf(buf, "%04d-%02d-%02d", nowTm->tm_year + 1900, nowTm->tm_mon + 1, nowTm->tm_mday);
  return String(buf);
}

// সহজ keyword overlap স্কোরিং (fuzzy matching এর বেসিক ভার্সন)
int keywordOverlapScore(String q1, String q2) {
  q1.toLowerCase();
  q2.toLowerCase();

  int score = 0;
  int start = 0;
  while (true) {
    int spaceIdx = q1.indexOf(' ', start);
    String word = (spaceIdx == -1) ? q1.substring(start) : q1.substring(start, spaceIdx);
    word.trim();
    if (word.length() > 1 && q2.indexOf(word) >= 0) score++;
    if (spaceIdx == -1) break;
    start = spaceIdx + 1;
  }
  return score;
}

void saveToLocalDatabase(String question, String answer, bool isVolatile) {
  File readFile = SD_MMC.open("/qa_database.json");
  if (!readFile) return;

  DynamicJsonDocument doc(20480);
  deserializeJson(doc, readFile);
  readFile.close();

  JsonArray arr = doc["questions"].as<JsonArray>();
  if (arr.isNull()) arr = doc.createNestedArray("questions"); // পুরনো ফাইল হলে key না-ও থাকতে পারে
  String today = getTodayDateString();

  // আগে চেক করুন প্রশ্নটা (উচ্চ মিল সহ) আগে থেকেই আছে কিনা -> থাকলে আপডেট করুন
  bool updated = false;
  for (JsonObject item : arr) {
    String storedQ = item["question"].as<String>();
    if (keywordOverlapScore(question, storedQ) >= 3) { // প্রায় হুবহু মিল
      item["answer"] = answer;
      item["volatile"] = isVolatile;
      item["last_updated"] = today;
      updated = true;
      break;
    }
  }

  if (!updated) {
    JsonObject newItem = arr.createNestedObject();
    newItem["question"] = question;
    newItem["answer"] = answer;
    newItem["volatile"] = isVolatile;
    newItem["last_updated"] = today;
  }

  File writeFile = SD_MMC.open("/qa_database.json", FILE_WRITE);
  if (writeFile) {
    serializeJson(doc, writeFile);
    writeFile.close();
    Serial.println(updated ? "পুরনো এন্ট্রি আপডেট করা হলো" : "নতুন প্রশ্ন-উত্তর সংরক্ষণ করা হলো");
  }
}

// ============================================================
// Call / SMS ভয়েস কমান্ড (API ছাড়া, প্যাটার্ন ম্যাচিং দিয়ে)
// ============================================================
// প্যাটার্ন: "<নাম>এর কাছে মেসেজ পাঠাও <মেসেজ>"
//        বা: "<নাম>কে কল দাও" / "<নাম>কে কল করো"
// bool রিটার্ন করে true যদি কল/SMS কমান্ড হিসেব��� হ্যান্ডেল হয়ে থাকে
// ============================================================
// "মনে রাখো" ভয়েস কমান্ড (API ছাড়াই সরাসরি SD card এ সেভ)
// ============================================================
// প্যাটার্ন: "মনে রাখো, <প্রশ্ন> মানে/হলো <উত্তর>"
//        বা: "মনে রাখো <তথ্য>" (পুরোটাই একসাথে প্রশ্ন+উত্তর হিসেবে ধরা কঠিন,
//             তাই "মানে" বা "হলো" ব্যবহার করলে সবচেয়ে ভালো কাজ করবে)
// ============================================================
// কম্পিউটার কন্ট্রোল কমান্ড (USB Serial দিয়ে, ল্যাপটপ/কম্পিউটার লাগানো থাকলে)
// ============================================================
// প্রতিটা কমান্ডে ESP32 একটা নির্দিষ্ট কোড-শব্দ Serial দিয়ে পাঠাবে,
// কম্পিউটারে চলা Python স্ক্রিপ্ট সেটা পড়ে সংশ্লিষ্ট কাজ করবে।
// USB ক্যাবল না লাগানো থাকলে এই Serial.println() শুধু "কোথাও যাবে না",
// কোনো এরর হবে না - তাই এটা যেকোনো সময় নিরাপদে ব্যবহার করা যায়।
bool handleComputerCommand(String question) {

  if (question.indexOf("ইউটিউব খোলো") >= 0 || question.indexOf("ইউটিউব খোল") >= 0) {
    Serial.println("PC_CMD:OPEN_YOUTUBE");
    speakAndShow("ইউটিউব খোলা হচ্ছে");
    return true;
  }

  if (question.indexOf("ব্রাউজার খোলো") >= 0 || question.indexOf("ব্রাউজার খোল") >= 0) {
    Serial.println("PC_CMD:OPEN_BROWSER");
    speakAndShow("ব্রাউজার খোলা হচ্ছে");
    return true;
  }

  if (question.indexOf("ভলিউম বাড়াও") >= 0 || question.indexOf("ভলিউম বাড়া") >= 0) {
    Serial.println("PC_CMD:VOLUME_UP");
    speakAndShow("ভলিউম বাড়ানো হচ্ছে");
    return true;
  }

  if (question.indexOf("ভলিউম কমাও") >= 0 || question.indexOf("ভলিউম কমা") >= 0) {
    Serial.println("PC_CMD:VOLUME_DOWN");
    speakAndShow("ভলিউম কমানো হচ্ছে");
    return true;
  }

  if (question.indexOf("গান থামাও") >= 0 || question.indexOf("মিউজিক থামাও") >= 0 ||
      question.indexOf("প্লে করো") >= 0 || question.indexOf("পজ করো") >= 0) {
    Serial.println("PC_CMD:PLAY_PAUSE");
    speakAndShow("প্লে-পজ করা হলো");
    return true;
  }

  if (question.indexOf("স্ক্রিনশট") >= 0) {
    Serial.println("PC_CMD:SCREENSHOT");
    speakAndShow("স্ক্রিনশট নেওয়া হচ্ছে");
    return true;
  }

  if (question.indexOf("কম্পিউটার লক করো") >= 0 || question.indexOf("পিসি লক করো") >= 0) {
    Serial.println("PC_CMD:LOCK_PC");
    speakAndShow("কম্পিউটার লক করা হচ্ছে");
    return true;
  }

  return false;
}

bool handleRememberCommand(String question) {
  int rememberIdx = question.indexOf("মনে রাখো");
  if (rememberIdx < 0) return false;

  // "মনে রাখো" এর পরের অংশ নিন
  String content = question.substring(rememberIdx + String("মনে রাখো").length());
  content.trim();
  if (content.startsWith(",")) {
    content = content.substring(1);
    content.trim();
  }

  if (content.length() == 0) {
    speakAndShow("কি মনে রাখতে হবে বলুন");
    return true;
  }

  // "মানে" বা "হলো" দিয়ে প্রশ্ন ও উত্তর আলাদা করার চেষ্টা
  int splitIdx = content.indexOf(" মানে ");
  int splitLen = 6; // " মানে " এর length
  if (splitIdx < 0) {
    splitIdx = content.indexOf(" হলো ");
    splitLen = 5;
  }

  String newQuestion, newAnswer;

  if (splitIdx >= 0) {
    // যেমন: "ঢাকার ডাক নাম মানে সিটি অফ মসজিদ"
    String subject = content.substring(0, splitIdx);
    newAnswer = content.substring(splitIdx + splitLen);
    subject.trim();
    newAnswer.trim();
    newQuestion = subject + " মানে কি"; // পরে "X মানে কি" জিজ্ঞেস করলে মিলবে
  } else {
    // "মানে/হলো" না থাকলে, পুরো কথাটাই প্রশ্ন হিসেবে রাখা হবে,
    // এবং একই কথাটাই উত্তর হিসেবেও সেভ হবে (fallback)
    newQuestion = content;
    newAnswer = content;
  }

  saveToLocalDatabase(newQuestion, newAnswer, false); // volatile না, স্থায়ী তথ্য হিসেবে সেভ
  speakAndShow("মনে রাখলাম: " + newQuestion);
  return true;
}

bool handleCallOrSMSCommand(String question) {

  // ---------- SMS কমান্ড চেক ----------
  int msgIdx = question.indexOf("মেসেজ পাঠাও");
  if (msgIdx >= 0) {
    String namePart = question.substring(0, msgIdx);
    String messagePart = question.substring(msgIdx + String("মেসেজ পাঠাও").length());

    namePart.trim();
    messagePart.trim();

    // নামের শেষে থাকা "কাছে", "এর কাছে", "র কাছে" বাদ দেওয়া
    namePart.replace("এর কাছে", "");
    namePart.replace("র কাছে", "");
    namePart.replace("কাছে", "");
    namePart.trim();

    String number = lookupContactNumber(namePart);

    if (number == "") {
      speakAndShow(namePart + " এর নাম্বার খুঁজে পাইনি");
      return true;
    }
    if (messagePart == "") {
      speakAndShow("মেসেজে কি লিখতে হবে বুঝতে পারিনি");
      return true;
    }

    triggerSMS(number, messagePart);
    speakAndShow(namePart + " কে মেসেজ পাঠানো হচ্ছে");
    return true;
  }

  // ---------- Call কমান্ড চেক ----------
  int callIdx = -1;
  String callKeyword = "";
  const char* callPhrases[] = {"কে কল দাও", "কে কল করো", "কে ফোন দাও", "কে ফোন করো"};
  for (int i = 0; i < 4; i++) {
    int idx = question.indexOf(callPhrases[i]);
    if (idx >= 0) {
      callIdx = idx;
      callKeyword = callPhrases[i];
      break;
    }
  }

  if (callIdx >= 0) {
    String namePart = question.substring(0, callIdx);
    namePart.trim();

    String number = lookupContactNumber(namePart);
    if (number == "") {
      speakAndShow(namePart + " এর নাম্বার খুঁজে পাইনি");
      return true;
    }

    triggerPhoneCall(number);
    speakAndShow(namePart + " কে কল করা হচ্ছে");
    return true;
  }

  return false; // এটা কল/SMS কমান্ড না, স্বাভাবিক প্রশ্ন হিসেবে প্রসেস হবে
}

// qa_database.json এর "contacts" key থেকে নাম দিয়ে নাম্বার খোঁজা
// ফরম্যাট: {"contacts":[{"name":"মা","number":"017XXXXXXXX"}, ...], ...}
String lookupContactNumber(String spokenName) {
  File file = SD_MMC.open("/qa_database.json");
  if (!file) {
    Serial.println("qa_database.json পাওয়া যায়নি!");
    return "";
  }

  DynamicJsonDocument doc(20480);
  DeserializationError error = deserializeJson(doc, file);
  file.close();
  if (error) return "";

  JsonArray arr = doc["contacts"].as<JsonArray>();
  for (JsonObject item : arr) {
    String storedName = item["name"].as<String>();
    // সহজ মিল: spokenName এর মধ্যে storedName আছে কিনা (বা উল্টো)
    if (spokenName.indexOf(storedName) >= 0 || storedName.indexOf(spokenName) >= 0) {
      return item["number"].as<String>();
    }
  }
  return "";
}

// URL এ পাঠানোর জন্য বাংলা/স্পেশাল ক্যারেক্টার percent-encode করা
String urlEncode(String str) {
  String encoded = "";
  char c;
  char buf[4];
  for (int i = 0; i < str.length(); i++) {
    c = str.charAt(i);
    if (isalnum(c)) {
      encoded += c;
    } else if (c == ' ') {
      encoded += '+';
    } else {
      sprintf(buf, "%%%02X", (unsigned char)c);
      encoded += buf;
    }
  }
  return encoded;
}

// MacroDroid webhook দিয়ে SMS পাঠানো (আপনার ফোনের মাধ্যমে)
void triggerSMS(String number, String message) {
  if (WiFi.status() != WL_CONNECTED) return;

  // SMS পাঠানোর জন্য MacroDroid webhook
  String baseUrl = "https://trigger.macrodroid.com/cd997d99-77d7-4591-9fb7-b97a35d914be/triggerSMS";

  String url = baseUrl + "?sms_number=" + number + "&sms_message=" + urlEncode(message);

  HTTPClient http;
  http.begin(url);
  int httpCode = http.GET();
  Serial.println("SMS webhook কল করা হলো, কোড: " + String(httpCode));
  http.end();
}

// MacroDroid webhook দিয়ে কল করা (আপনার ফোনের মাধ্যমে)
void triggerPhoneCall(String number) {
  if (WiFi.status() != WL_CONNECTED) return;

  // *** আপনার Call webhook URL এখানে বসান ***
  String baseUrl = "https://trigger.macrodroid.com/cd997d99-77d7-4591-9fb7-b97a35d914be/call_trigger";

  String url = baseUrl + "?phone_number=" + number;

  HTTPClient http;
  http.begin(url);
  int httpCode = http.GET();
  Serial.println("Call webhook কল করা হলো, কোড: " + String(httpCode));
  http.end();
}

// ============================================================
// WiFi কানেকশন - SD card এর তালিকা থেকে স্বয়ংক্রিয়ভাবে (বাটন লাগবে না)
// ============================================================
// qa_database.json এর ভেতরে "wifi" key তে রাখুন:
// { "wifi": [
//     {"ssid": "Sourav", "password": "45sourav30"},
//     {"ssid": "বাসার_WiFi", "password": "পাসওয়ার্ড"}
//   ], "contacts": [...], "questions": [...] }
void setupWiFi() {
  showMessage("WiFi খোঁজা হচ্ছে...");
  Serial.println("SD card থেকে WiFi তালিকা পড়া হচ্ছে...");

  bool listLoaded = loadWiFiListFromSD();

  if (listLoaded) {
    int attempts = 0;
    while (wifiMulti.run() != WL_CONNECTED && attempts < 30) {
      delay(500);
      Serial.print(".");
      attempts++;
    }
  }

  if (WiFi.status() == WL_CONNECTED) {
    Serial.println("\nWiFi কানেক্টেড: " + WiFi.SSID());
    Serial.println("IP: " + WiFi.localIP().toString());
    showMessage("সংযুক্ত: " + WiFi.SSID());
    configTime(6 * 3600, 0, "pool.ntp.org", "time.nist.gov"); // GMT+6
    return;
  }

  // কোনো পরিচিত WiFi পাওয়া যায়নি -> সেটআপ পোর্টাল (শুধু প্রথমবার/নতুন জায়গায়)
  Serial.println("\nকোনো পরিচিত WiFi পাওয়া যায়নি, সেটআপ মোড চালু হচ্ছে...");
  showMessage("নতুন WiFi সেটআপ...");

  wifiManager.setConfigPortalTimeout(180);
  bool connected = wifiManager.autoConnect("VoiceAssistant-Setup");

  if (connected) {
    Serial.println("WiFi কানেক্টেড: " + WiFi.SSID());
    showMessage("সংযুক্ত: " + WiFi.SSID());
    configTime(6 * 3600, 0, "pool.ntp.org", "time.nist.gov");
  } else {
    Serial.println("WiFi সেটআপ ব্যর্থ! রিস্টার্ট হচ্ছে...");
    showMessage("WiFi সেটআপ ব্যর্থ!");
    delay(3000);
    ESP.restart();
  }
}

// qa_database.json এর "wifi" key পড়ে WiFiMulti তে যোগ করা
// ফরম্যাট: {"wifi":[{"ssid": "Sourav", "password": "45sourav30"}, ...], ...}
bool loadWiFiListFromSD() {
  File testFile = SD_MMC.open("/qa_database.json", FILE_READ);
  if (!testFile) {
    Serial.println("qa_database.json পাওয়া যায়নি");
    return false;
  }
  testFile.close();

  File file = SD_MMC.open("/qa_database.json");
  if (!file) return false;

  DynamicJsonDocument doc(20480);
  DeserializationError error = deserializeJson(doc, file);
  file.close();

  if (error) {
    Serial.println("qa_database.json পড়তে সমস্যা হয়েছে");
    return false;
  }

  JsonArray arr = doc["wifi"].as<JsonArray>();
  int count = 0;
  for (JsonObject item : arr) {
    String ssid = item["ssid"].as<String>();
    String pass = item["password"].as<String>();
    wifiMulti.addAP(ssid.c_str(), pass.c_str());
    count++;
  }

  Serial.println(String(count) + "টা WiFi তালিকায় যোগ করা হলো");
  return count > 0;
}

// প্রয়োজনে (যেমন ভুল পাসওয়ার্ড দেওয়া হলে) সেভ করা WiFi তথ্য
// মুছে আবার নতুন করে সেটআপ করতে এই ফাংশন কল করতে পারেন
void resetWiFiSettings() {
  wifiManager.resetSettings();
  Serial.println("WiFi সেটিংস মুছে ফেলা হলো, রিস্টার্ট হচ্ছে...");
  delay(1000);
  ESP.restart();
}
// ============================================================
// ফন্ট ডেটা: HindSiliguri18 (TFT_eSPI Smooth Font, .h কনভার্টার
// দিয়ে তৈরি) - আগে এটা আলাদা HindSiliguri18Font.h ফাইলে ছিল এবং
// #include দিয়েও আনা হচ্ছিল, ফলে "redefinition of HindSiliguri18"
// এরর হচ্ছিল। এখন এটা সরাসরি এই .ino ফাইলেই একবারই রাখা হলো।
// ============================================================
const uint8_t HindSiliguri18[] PROGMEM = {
  0x00, 0x00, 0x00, 0xa9, 0x00, 0x00, 0x00, 0x0b, 0x00, 0x00, 0x00, 0x12, 0x00, 0x00, 0x00, 0x00,
  0x00, 0x00, 0x00, 0x14, 0x00, 0x00, 0x00, 0x09, 0x00, 0x00, 0x00, 0x21, 0x00, 0x00, 0x00, 0x0e,
  0x00, 0x00, 0x00, 0x03, 0x00, 0x00, 0x00, 0x05, 0x00, 0x00, 0x00, 0x0d, 0x00, 0x00, 0x00, 0x01,
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  0x67, 0x75, 0x6c, 0x61, 0x72, 0x01,
};
